## Kconfig.local
```kconfig
config BACKPORTED_BACKPORT_DIR
	tristate
	default BACKPORT_DIR
config BACKPORTED_BACKPORTS_VERSION
	tristate
	default BACKPORTS_VERSION
config BACKPORTED_BACKPORTED_KERNEL_VERSION
	tristate
	default BACKPORTED_KERNEL_VERSION
config BACKPORTED_BACKPORTED_KERNEL_NAME
	tristate
	default BACKPORTED_KERNEL_NAME
config BACKPORTED_WIRELESS
	tristate
	default WIRELESS
config BACKPORTED_NET_CORE
	tristate
	default NET_CORE
config BACKPORTED_EXPERT
	tristate
	default EXPERT
config BACKPORTED_BP_MODULES
	tristate
	default BP_MODULES
config BACKPORTED_BPAUTO_BUILD_CORDIC
	tristate
	default BPAUTO_BUILD_CORDIC
config BACKPORTED_BPAUTO_CORDIC
	tristate
	default BPAUTO_CORDIC
config BACKPORTED_BPAUTO_MII
	tristate
	default BPAUTO_MII
config BACKPORTED_BPAUTO_BUILD_LEDS
	tristate
	default BPAUTO_BUILD_LEDS
config BACKPORTED_BPAUTO_NEW_LEDS
	tristate
	default BPAUTO_NEW_LEDS
config BACKPORTED_BPAUTO_LEDS_CLASS
	tristate
	default BPAUTO_LEDS_CLASS
config BACKPORTED_BPAUTO_LEDS_TRIGGERS
	tristate
	default BPAUTO_LEDS_TRIGGERS
config BACKPORTED_BPAUTO_USERSEL_BUILD_ALL
	tristate
	default BPAUTO_USERSEL_BUILD_ALL
config BACKPORTED_BPAUTO_CRYPTO_CCM
	tristate
	default BPAUTO_CRYPTO_CCM
config BACKPORTED_BPAUTO_BUILD_CRYPTO_CCM
	tristate
	default BPAUTO_BUILD_CRYPTO_CCM
config BACKPORTED_BPAUTO_CRYPTO_SKCIPHER
	tristate
	default BPAUTO_CRYPTO_SKCIPHER
config BACKPORTED_BPAUTO_WANT_DEV_COREDUMP
	tristate
	default BPAUTO_WANT_DEV_COREDUMP
config BACKPORTED_BPAUTO_BUILD_WANT_DEV_COREDUMP
	tristate
	default BPAUTO_BUILD_WANT_DEV_COREDUMP
config BACKPORTED_BPAUTO_RHASHTABLE
	tristate
	default BPAUTO_RHASHTABLE
config BACKPORTED_BPAUTO_BUILD_HDMI
	tristate
	default BPAUTO_BUILD_HDMI
config BACKPORTED_BPAUTO_HDMI
	tristate
	default BPAUTO_HDMI
config BACKPORTED_BPAUTO_FRAME_VECTOR
	tristate
	default BPAUTO_FRAME_VECTOR
config BACKPORTED_BPAUTO_BUILD_FRAME_VECTOR
	tristate
	default BPAUTO_BUILD_FRAME_VECTOR
config BACKPORTED_BPAUTO_REFCOUNT
	tristate
	default BPAUTO_REFCOUNT
config BACKPORTED_CFG80211
	tristate
	default CFG80211
config BACKPORTED_NL80211_TESTMODE
	tristate
	default NL80211_TESTMODE
config BACKPORTED_CFG80211_DEVELOPER_WARNINGS
	tristate
	default CFG80211_DEVELOPER_WARNINGS
config BACKPORTED_CFG80211_CERTIFICATION_ONUS
	tristate
	default CFG80211_CERTIFICATION_ONUS
config BACKPORTED_CFG80211_REG_CELLULAR_HINTS
	tristate
	default CFG80211_REG_CELLULAR_HINTS
config BACKPORTED_CFG80211_REG_RELAX_NO_IR
	tristate
	default CFG80211_REG_RELAX_NO_IR
config BACKPORTED_CFG80211_DEFAULT_PS
	tristate
	default CFG80211_DEFAULT_PS
config BACKPORTED_CFG80211_DEBUGFS
	tristate
	default CFG80211_DEBUGFS
config BACKPORTED_CFG80211_INTERNAL_REGDB
	tristate
	default CFG80211_INTERNAL_REGDB
config BACKPORTED_CFG80211_CRDA_SUPPORT
	tristate
	default CFG80211_CRDA_SUPPORT
config BACKPORTED_CFG80211_WEXT
	tristate
	default CFG80211_WEXT
config BACKPORTED_CFG80211_WEXT_EXPORT
	tristate
	default CFG80211_WEXT_EXPORT
config BACKPORTED_LIB80211
	tristate
	default LIB80211
config BACKPORTED_LIB80211_CRYPT_WEP
	tristate
	default LIB80211_CRYPT_WEP
config BACKPORTED_LIB80211_CRYPT_CCMP
	tristate
	default LIB80211_CRYPT_CCMP
config BACKPORTED_LIB80211_CRYPT_TKIP
	tristate
	default LIB80211_CRYPT_TKIP
config BACKPORTED_LIB80211_DEBUG
	tristate
	default LIB80211_DEBUG
config BACKPORTED_MAC80211
	tristate
	default MAC80211
config BACKPORTED_MAC80211_HAS_RC
	tristate
	default MAC80211_HAS_RC
config BACKPORTED_MAC80211_RC_MINSTREL
	tristate
	default MAC80211_RC_MINSTREL
config BACKPORTED_MAC80211_RC_MINSTREL_HT
	tristate
	default MAC80211_RC_MINSTREL_HT
config BACKPORTED_MAC80211_RC_MINSTREL_VHT
	tristate
	default MAC80211_RC_MINSTREL_VHT
config BACKPORTED_MAC80211_RC_DEFAULT_MINSTREL
	tristate
	default MAC80211_RC_DEFAULT_MINSTREL
config BACKPORTED_MAC80211_RC_DEFAULT
	tristate
	default MAC80211_RC_DEFAULT
config BACKPORTED_MAC80211_MESH
	tristate
	default MAC80211_MESH
config BACKPORTED_MAC80211_LEDS
	tristate
	default MAC80211_LEDS
config BACKPORTED_MAC80211_DEBUGFS
	tristate
	default MAC80211_DEBUGFS
config BACKPORTED_MAC80211_MESSAGE_TRACING
	tristate
	default MAC80211_MESSAGE_TRACING
config BACKPORTED_MAC80211_DEBUG_MENU
	tristate
	default MAC80211_DEBUG_MENU
config BACKPORTED_MAC80211_NOINLINE
	tristate
	default MAC80211_NOINLINE
config BACKPORTED_MAC80211_VERBOSE_DEBUG
	tristate
	default MAC80211_VERBOSE_DEBUG
config BACKPORTED_MAC80211_MLME_DEBUG
	tristate
	default MAC80211_MLME_DEBUG
config BACKPORTED_MAC80211_STA_DEBUG
	tristate
	default MAC80211_STA_DEBUG
config BACKPORTED_MAC80211_HT_DEBUG
	tristate
	default MAC80211_HT_DEBUG
config BACKPORTED_MAC80211_OCB_DEBUG
	tristate
	default MAC80211_OCB_DEBUG
config BACKPORTED_MAC80211_IBSS_DEBUG
	tristate
	default MAC80211_IBSS_DEBUG
config BACKPORTED_MAC80211_PS_DEBUG
	tristate
	default MAC80211_PS_DEBUG
config BACKPORTED_MAC80211_MPL_DEBUG
	tristate
	default MAC80211_MPL_DEBUG
config BACKPORTED_MAC80211_MPATH_DEBUG
	tristate
	default MAC80211_MPATH_DEBUG
config BACKPORTED_MAC80211_MHWMP_DEBUG
	tristate
	default MAC80211_MHWMP_DEBUG
config BACKPORTED_MAC80211_MESH_SYNC_DEBUG
	tristate
	default MAC80211_MESH_SYNC_DEBUG
config BACKPORTED_MAC80211_MESH_CSA_DEBUG
	tristate
	default MAC80211_MESH_CSA_DEBUG
config BACKPORTED_MAC80211_MESH_PS_DEBUG
	tristate
	default MAC80211_MESH_PS_DEBUG
config BACKPORTED_MAC80211_TDLS_DEBUG
	tristate
	default MAC80211_TDLS_DEBUG
config BACKPORTED_MAC80211_DEBUG_COUNTERS
	tristate
	default MAC80211_DEBUG_COUNTERS
config BACKPORTED_MAC80211_STA_HASH_MAX_SIZE
	tristate
	default MAC80211_STA_HASH_MAX_SIZE
config BACKPORTED_WLAN
	tristate
	default WLAN
config BACKPORTED_WIRELESS_WDS
	tristate
	default WIRELESS_WDS
config BACKPORTED_PCMCIA_RAYCS
	tristate
	default PCMCIA_RAYCS
config BACKPORTED_PCMCIA_WL3501
	tristate
	default PCMCIA_WL3501
config BACKPORTED_MAC80211_HWSIM
	tristate
	default MAC80211_HWSIM
config BACKPORTED_USB_NET_RNDIS_WLAN
	tristate
	default USB_NET_RNDIS_WLAN
config BACKPORTED_ATH_COMMON
	tristate
	default ATH_COMMON
config BACKPORTED_WLAN_VENDOR_ATH
	tristate
	default WLAN_VENDOR_ATH
config BACKPORTED_ATH_DEBUG
	tristate
	default ATH_DEBUG
config BACKPORTED_ATH_TRACEPOINTS
	tristate
	default ATH_TRACEPOINTS
config BACKPORTED_ATH_REG_DYNAMIC_USER_REG_HINTS
	tristate
	default ATH_REG_DYNAMIC_USER_REG_HINTS
config BACKPORTED_ATH_REG_DYNAMIC_USER_CERT_TESTING
	tristate
	default ATH_REG_DYNAMIC_USER_CERT_TESTING
config BACKPORTED_ATH9K_HW
	tristate
	default ATH9K_HW
config BACKPORTED_ATH9K_COMMON
	tristate
	default ATH9K_COMMON
config BACKPORTED_ATH9K_COMMON_DEBUG
	tristate
	default ATH9K_COMMON_DEBUG
config BACKPORTED_ATH9K_DFS_DEBUGFS
	tristate
	default ATH9K_DFS_DEBUGFS
config BACKPORTED_ATH9K_BTCOEX_SUPPORT
	tristate
	default ATH9K_BTCOEX_SUPPORT
config BACKPORTED_ATH9K
	tristate
	default ATH9K
config BACKPORTED_ATH9K_PCI
	tristate
	default ATH9K_PCI
config BACKPORTED_ATH9K_AHB
	tristate
	default ATH9K_AHB
config BACKPORTED_ATH9K_DEBUGFS
	tristate
	default ATH9K_DEBUGFS
config BACKPORTED_ATH9K_STATION_STATISTICS
	tristate
	default ATH9K_STATION_STATISTICS
config BACKPORTED_ATH9K_TX99
	tristate
	default ATH9K_TX99
config BACKPORTED_ATH9K_DFS_CERTIFIED
	tristate
	default ATH9K_DFS_CERTIFIED
config BACKPORTED_ATH9K_DYNACK
	tristate
	default ATH9K_DYNACK
config BACKPORTED_ATH9K_WOW
	tristate
	default ATH9K_WOW
config BACKPORTED_ATH9K_RFKILL
	tristate
	default ATH9K_RFKILL
config BACKPORTED_ATH9K_CHANNEL_CONTEXT
	tristate
	default ATH9K_CHANNEL_CONTEXT
config BACKPORTED_ATH9K_PCOEM
	tristate
	default ATH9K_PCOEM
config BACKPORTED_ATH9K_HTC
	tristate
	default ATH9K_HTC
config BACKPORTED_ATH9K_HTC_DEBUGFS
	tristate
	default ATH9K_HTC_DEBUGFS
config BACKPORTED_ATH9K_HWRNG
	tristate
	default ATH9K_HWRNG
config BACKPORTED_ATH6KL
	tristate
	default ATH6KL
config BACKPORTED_ATH6KL_SDIO
	tristate
	default ATH6KL_SDIO
config BACKPORTED_ATH6KL_USB
	tristate
	default ATH6KL_USB
config BACKPORTED_ATH6KL_DEBUG
	tristate
	default ATH6KL_DEBUG
config BACKPORTED_ATH6KL_TRACING
	tristate
	default ATH6KL_TRACING
config BACKPORTED_ATH6KL_REGDOMAIN
	tristate
	default ATH6KL_REGDOMAIN
config BACKPORTED_WIL6210
	tristate
	default WIL6210
config BACKPORTED_WIL6210_ISR_COR
	tristate
	default WIL6210_ISR_COR
config BACKPORTED_WIL6210_TRACING
	tristate
	default WIL6210_TRACING
config BACKPORTED_WIL6210_DEBUGFS
	tristate
	default WIL6210_DEBUGFS
config BACKPORTED_ATH10K
	tristate
	default ATH10K
config BACKPORTED_ATH10K_PCI
	tristate
	default ATH10K_PCI
config BACKPORTED_ATH10K_AHB
	tristate
	default ATH10K_AHB
config BACKPORTED_ATH10K_SDIO
	tristate
	default ATH10K_SDIO
config BACKPORTED_ATH10K_USB
	tristate
	default ATH10K_USB
config BACKPORTED_ATH10K_DEBUG
	tristate
	default ATH10K_DEBUG
config BACKPORTED_ATH10K_DEBUGFS
	tristate
	default ATH10K_DEBUGFS
config BACKPORTED_ATH10K_TRACING
	tristate
	default ATH10K_TRACING
config BACKPORTED_ATH10K_DFS_CERTIFIED
	tristate
	default ATH10K_DFS_CERTIFIED
```
